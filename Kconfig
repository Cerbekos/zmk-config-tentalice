## Kconfig
```kconfig
menuconfig TENTALICE_RUNTIME_INPUT
	bool "Tentalice runtime pointing configuration"
	default y
	depends on ZMK_POINTING
```

## dts/bindings/behaviors/zmk,behavior-tentalice-mouse-gesture.yaml
```yaml
description: Enables mouse gesture recognition while held

compatible: "zmk,behavior-tentalice-mouse-gesture"

include: zero_param.yaml

properties:
  display-name:
    type: string
    required: true
```

## dts/bindings/behaviors/zmk,behavior-tentalice-setting.yaml
```yaml
description: Stores one Tentalice runtime setting in the hidden Studio layer

compatible: "zmk,behavior-tentalice-setting"

include: two_param.yaml

properties:
  display-name:
    type: string
    required: true
```

## dts/bindings/input-processors/zmk,input-processor-tentalice.yaml
```yaml
description: Tentalice runtime-configurable pointing input processor

compatible: "zmk,input-processor-tentalice"

include: input-processor.yaml

properties:
  mode:
    type: int
    required: true
    enum:
      - 0
      - 1
      - 2
      - 3
```

## dts/bindings/input_processors/zmk,input-processor-tentalice.yaml
```yaml
description: Tentalice runtime-configurable pointing input processor

compatible: "zmk,input-processor-tentalice"

properties:
  "#input-processor-cells":
    type: int
    const: 0
    description: Number of cells in input processor specifier

  track-remainders:
    type: boolean
    description: Track fractional input values between events

  mode:
    type: int
    required: true
    enum:
      - 0
      - 1
      - 2
      - 3
```
